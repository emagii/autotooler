## autotooler/Config.in
```kconfig
mainmenu "Application/Library Configuration"

config	HAVE_DOT_CONFIG
	bool
	default y
	help
	  Indicate that have an included file.

config	CONFIG_PROJECT
	string	"Project Name"
	default "myproject"

source	Platform.in

config	CONFIG_SRC_URI_HOST
	string	"git path"
	default	"https://www.github.com/emagii"

config	CONFIG_SRC_URI_REPO
	string	"git repo (if LIBRARY_NAME is wrong)"
	default	""
	help
	  if git repo is empty, we will clone from <CONFIG_LIBRARY_NAME>.git

config	CONFIG_WORKDIR
	string	"workdir"
	default	"${HOME}/projects/autotooler"
	help
	  All libraries will be cloned here

config	CONFIG_PROJECT_TYPE
	string
	default "program"	if CONFIG_PROGRAM
	default "library"	if CONFIG_LIBRARY

# ===============================================
#
# ===============================================
choice
	prompt "Build Target"
	default CONFIG_SHARED_LIB

config	CONFIG_APP
	bool "Build an Application"
	help
	  Use this mode to load an second level boot monitor
	  like U-boot into the last MB of SDRAM.

config	CONFIG_SHARED_LIB
	bool "Build a Shared Library"
	---help---
	   Load Linux kernel directly from storage media

config	CONFIG_STATIC_LIB
	bool "Build a Static Library"
	help
	  Use this mode to load an embedded application
	  which can have a size of up to 1 MByte
endchoice
# ===============================================

config	CONFIG_LIBRARY
	bool
	default	y	if CONFIG_SHARED_LIB
	default	y	if CONFIG_STATIC_LIB
	default	n

# ===============================================
#
# ===============================================
if	CONFIG_LIBRARY
menu "Library Setup"

config	CONFIG_LIBRARY_NAME
	string "Library Name"
	default "lib<x>"
	
config	CONFIG_LIBRARY_VERSION
	string "Library Version"
	default "1.0"

config	CONFIG_LIBRARY_INSTALLDIR
	string "Library Header Install directory"
	default ""

config	CONFIG_LIBRARY_UNIT_TEST
	bool	"Unit Test"
	default	n
	help
	  Is there an application to test the library?
	  (Not Yet Supported)

if	CONFIG_LIBRARY_UNIT_TEST
config	CONFIG_LIBRARY_UNIT_TEST_NAME
	string	"Unit Test Name"
	default	""
	help
	  (Not Yet Supported)

endif

endmenu
endif

if	CONFIG_APP
menu "Program Setup"

config	CONFIG_APP_NAME
	string "Application Name"
	default "myapp"

config	CONFIG_APP_VERSION
	string "Application Version"
	default "1.0"

config	CONFIG_APP_EXTRA
	bool	"Build generates more than one binary or library?"
	default	n
	help
	  If the build generates more than one binary, they need to be listed

if	CONFIG_APP_EXTRA
config	CONFIG_APP_EXTRA_APPS
	string	"<app1> {, <app2> }"
	help
	  Comma separated list of applications to build

config	CONFIG_APP_EXTRA_LIBS
	string	"<lib1> { , <lib2> }"
	help
	  Comma separated list of libraries to build
	  (Not Yet Supported)

endif

endmenu
endif
# ===============================================

config	CONFIG_COPYRIGHT_DATE
	string "Copyright Date '2016-2017"
	default "2017"
	
config	CONFIG_AUTHOR
	string "Author Name"
	default	"Ulf Samuelsson"

config	CONFIG_AUTHOR_EMAIL
	string "email: author@domain.com"
	default	"ulf@emagii.com"

config	CONFIG_HOMEPAGE
	string "homepage: http://www.example.com/"
	default	"http://www.emagii.com/"

config	CONFIG_AC_PRERQ
	string	"CONFIG_AC_PRERQ"
	default	"2.59"

config	CONFIG_AC_CONFIG_HEADER
	string "AC_INIT Header (config.h)"
	default	"src/user/config.h"

config	CONFIG_AC_CONFIG_MACRO_DIR
	string "AC_CONFIG_MACRO_DIR (m4)"
	default	"m4"

config	CONFIG_AM_INIT_AUTOMAKE
	string "AM_INIT_AUTOMAKE (1.10 -Wall no-define)"
	default	"1.10 -Wall no-define"

config	CONFIG_SRCDIR
	string	"Source Code directory"
	default	"src"

# ===============================================
#
# ===============================================
menu "Linker Libraries"

config	CONFIG_BOOST
	bool	"Boost Library"

config	CONFIG_CURL
	bool	"cURL"

config	CONFIG_FTD2XX
	bool	"FTDI MPSSE Library (ftd2xx)"

config	CONFIG_OPENSSL
	bool	"OpenSSL"

config	CONFIG_PTHREAD
	bool	"PThread"

source	"src/user/Config-libs.in"
endmenu

source	library/Config.in

# ===============================================


# ===============================================
#
# ===============================================
menu	"Options"
# ===============================================


#config	CONFIG_OS
#	string
#	default	"Android"	if CONFIG_OS_ANDROID
#	default	"iOS"		if CONFIG_OS_IOS
#	default	"Linux"		if CONFIG_OS_LINUX
#	default	"Mac OS X"	if CONFIG_OS_MAC_X
#	default	"Windows"	if CONFIG_OS_WINDOWS
#	default	"other"		if CONFIG_OS_OTHER

config	CONFIG_DEBUG
	bool	"debug"

config	CONFIG_DEBUG_VAR
	depends	on CONFIG_DEBUG
	string	"debug	--enable-<var>"
	default	"debug"

### user options
#
#
source	"src/user/Config.in"
#
#
### end user options

endmenu
```

## autotooler/library/Config.in
```kconfig
menu	"Check Libraries"

source	library/dl/Config.in
source	library/ftd2xx/Config.in
source	library/nsl/Config.in
source	library/socket/Config.in

endmenu
```

## autotooler/library/dl/Config.in
```kconfig
menu	"Check dl"
config		CONFIG_LIB_DL_DLOPEN
		bool	"dlopen"
		default	n
endmenu
```

## autotooler/library/ftd2xx/Config.in
```kconfig
menu	"Check ftd2xx"
config		CONFIG_LIB_FTD2XX_FT_OPEN
		bool	"ftd2xx"
		default	n
endmenu
```

## autotooler/library/nsl/Config.in
```kconfig
menu	"Check nsl"
config		CONFIG_LIB_NSL_GETHOSTBYNAME
		bool	"gethostbyname"
		default	n
endmenu
```

## autotooler/library/socket/Config.in
```kconfig
menu	"Check socket"
config		CONFIG_LIB_SOCKET_SOCKET
		bool	"socket"
		default	n
endmenu
```
